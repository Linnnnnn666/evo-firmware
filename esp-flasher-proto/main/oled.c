// SSD1306 OLED 驱动（128x64, I2C）——烧录工作台 HUD
#include "oled.h"

#include <string.h>

#include "cn_font.h"
#include "driver/i2c_master.h"
#include "esp_log.h"
#include "freertos/FreeRTOS.h"
#include "freertos/task.h"

static const char *TAG = "oled";

#define OLED_ADDR   0x3C
#define OLED_W      128
#define OLED_H      64
#define OLED_PAGES  8   // 64/8

// I2C 引脚（N16R8 空闲引脚；可改）
#define I2C_PORT    I2C_NUM_0
#define I2C_SDA     8
#define I2C_SCL     9
#define I2C_FREQ    400000

static i2c_master_dev_handle_t s_dev = NULL;
static i2c_master_bus_handle_t s_bus = NULL;  // 保存总线句柄（防止生命周期问题）
static uint8_t s_fb[OLED_W * OLED_PAGES];  // 显示缓冲

// ---------- 底层 ----------
static void oled_cmd(uint8_t cmd) {
    uint8_t buf[2] = {0x00, cmd};
    if (s_dev) i2c_master_transmit(s_dev, buf, 2, 100);
}

static void oled_data(const uint8_t *data, uint32_t len) {
    if (!s_dev) return;
    uint8_t *buf = malloc(len + 1);
    if (!buf) return;
    buf[0] = 0x40;
    memcpy(buf + 1, data, len);
    i2c_master_transmit(s_dev, buf, len + 1, 100);
    free(buf);
}

// ---------- 初始化 ----------
bool oled_init(void) {
    i2c_master_bus_config_t bus_cfg = {
        .i2c_port = I2C_PORT,
        .sda_io_num = I2C_SDA,
        .scl_io_num = I2C_SCL,
        .clk_source = I2C_CLK_SRC_DEFAULT,
        .glitch_ignore_cnt = 7,
        .flags.enable_internal_pullup = true,
    };
    i2c_master_bus_handle_t bus = NULL;
    if (i2c_new_master_bus(&bus_cfg, &bus) != ESP_OK) {
        ESP_LOGE(TAG, "I2C 总线创建失败（SDA=%d SCL=%d）", I2C_SDA, I2C_SCL);
        return false;
    }
    s_bus = bus;
    i2c_device_config_t dev_cfg = {
        .dev_addr_length = I2C_ADDR_BIT_LEN_7,
        .device_address = OLED_ADDR,
        .scl_speed_hz = I2C_FREQ,
    };
    if (i2c_master_bus_add_device(bus, &dev_cfg, &s_dev) != ESP_OK) {
        ESP_LOGE(TAG, "OLED 设备添加失败");
        return false;
    }

    // SSD1306 初始化序列
    static const uint8_t init_seq[] = {
        0xAE,             // display off
        0xD5, 0x80,       // clock div
        0xA8, 0x3F,       // multiplex 1/64
        0xD3, 0x00,       // display offset
        0x40,             // start line 0
        0x8D, 0x14,       // charge pump on
        0x20, 0x00,       // horizontal memory mode
        0xA1,             // segment remap
        0xC8,             // COM scan dec
        0xDA, 0x12,       // COM pins
        0x81, 0xCF,       // contrast
        0xD9, 0xF1,       // precharge
        0xDB, 0x40,       // VCOM detect
        0xA4,             // display all on resume
        0xA6,             // normal display
        0xAF,             // display on
    };
    for (uint32_t i = 0; i < sizeof(init_seq); i++) {
        oled_cmd(init_seq[i]);
    }
    oled_clear();
    oled_show();
    ESP_LOGI(TAG, "OLED 初始化完成 (0x%02X, SDA=%d SCL=%d)", OLED_ADDR, I2C_SDA, I2C_SCL);
    return true;
}

// ---------- 缓冲操作 ----------
void oled_clear(void) {
    memset(s_fb, 0, sizeof(s_fb));
}

void oled_show(void) {
    for (uint8_t page = 0; page < OLED_PAGES; page++) {
        oled_cmd(0xB0 + page);  // page addr
        oled_cmd(0x00);         // col low
        oled_cmd(0x10);         // col high
        oled_data(s_fb + page * OLED_W, OLED_W);
    }
}

// ---------- 5x7 ASCII 字库（32..126） ----------
static const uint8_t FONT5X7[][5] = {
    {0x00,0x00,0x00,0x00,0x00}, // space
    {0x00,0x00,0x5F,0x00,0x00}, // !
    {0x00,0x07,0x00,0x07,0x00}, // "
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    {0x08,0x08,0x2A,0x1C,0x08}, // ~
};

void oled_text(uint8_t x, uint8_t y, const char *s) {
    if (y >= OLED_PAGES || !s) return;
    for (; *s && x <= OLED_W / 6 - 1; s++, x++) {
        uint8_t c = (uint8_t)(*s);
        if (c < 32 || c > 126) c = ' ';
        const uint8_t *g = FONT5X7[c - 32];
        uint8_t *dst = s_fb + y * OLED_W + x * 6;
        for (int col = 0; col < 5; col++) {
            dst[col] = g[col];
        }
        dst[5] = 0;  // 字符间距
    }
}

void oled_bar(uint8_t x, uint8_t y, uint8_t w, uint8_t h, uint8_t pct) {
    if (y >= OLED_PAGES || pct > 100) return;
    uint8_t fill = (uint8_t)(w * pct / 100);
    for (uint8_t row = 0; row < h; row++) {
        uint8_t *dst = s_fb + (y + row) * OLED_W + x;
        for (uint8_t col = 0; col < w; col++) {
            dst[col] = (col < fill) ? 0xFF : 0x00;
        }
    }
}

// 16x16 数字/大写字母（状态大字），支持 0-9 A-Z . - space
static const uint8_t FONT16[][32] = {
    // 0
    {0x00,0x07,0x0F,0x1C,0x1C,0x1C,0x1C,0x0F,0x07,0x00,0x00,0x00,0x00,0x00,0x00,0x00,
     0xF0,0xFC,0x0E,0x07,0x03,0x03,0x07,0x0E,0xFC,0xF0,0x00,0x00,0x00,0x00,0x00,0x00},
    // 1
    {0x00,0x0C,0x0C,0x0E,0x0F,0x0F,0x0C,0x0C,0x0C,0x00,0x00,0x00,0x00,0x00,0x00,0x00,
     0x00,0x00,0x00,0x00,0x00,0x80,0xE0,0xF0,0xFC,0xFC,0x00,0x00,0x00,0x00,0x00,0x00},
    // 2
    {0x00,0x0E,0x1F,0x1C,0x1C,0x1C,0x1C,0x0E,0x07,0x00,0x00,0x00,0x00,0x00,0x00,0x00,
     0x00,0x00,0x06,0x07,0x03,0x03,0x03,0x07,0x0E,0xFC,0xF8,0x00,0x00,0x00,0x00,0x00},
    // 3
    {0x00,0x0E,0x1F,0x1C,0x1C,0x1C,0x1C,0x0F,0x07,0x00,0x00,0x00,0x00,0x00,0x00,0x00,
     0x00,0x00,0x02,0x03,0x03,0x83,0x83,0xC7,0xFE,0x7C,0x00,0x00,0x00,0x00,0x00,0x00},
    // 4
    {0x00,0x1C,0x1C,0x1E,0x0F,0x07,0x0F,0x1E,0x1C,0x1C,0x00,0x00,0x00,0x00,0x00,0x00,
     0x00,0x00,0xC0,0xC0,0xC0,0xC0,0xFC,0xFC,0xFC,0xC0,0xC0,0xC0,0x00,0x00,0x00,0x00},
    // 5
    {0x00,0x07,0x0F,0x0E,0x0E,0x0E,0x0E,0x0E,0x0E,0x00,0x00,0x00,0x00,0x00,0x00,0x00,
     0x00,0x00,0xFC,0xFC,0xCC,0xCC,0xCC,0xCC,0x8C,0x0C,0x00,0x00,0x00,0x00,0x00,0x00},
    // 6
    {0x00,0x0F,0x1F,0x1C,0x1C,0x1C,0x1C,0x0C,0x00,0x00,0x00,0x00,0x00,0x00,0x00,0x00,
     0x00,0xF8,0xFC,0x8E,0x86,0x86,0x86,0x8E,0xFC,0xF8,0x00,0x00,0x00,0x00,0x00,0x00},
    // 7
    {0x00,0x00,0x00,0x00,0x0C,0x0C,0x0C,0x0C,0x0F,0x0F,0x0C,0x00,0x00,0x00,0x00,0x00,
     0x00,0x00,0x00,0x00,0x00,0x00,0x80,0xE0,0xF8,0xFE,0x1F,0x03,0x00,0x00,0x00,0x00},
    // 8
    {0x00,0x07,0x0F,0x1C,0x1C,0x1C,0x1C,0x0F,0x07,0x00,0x00,0x00,0x00,0x00,0x00,0x00,
     0x00,0x7C,0xFE,0xC7,0x83,0x83,0x83,0xC7,0xFE,0x7C,0x00,0x00,0x00,0x00,0x00,0x00},
    // 9
    {0x00,0x07,0x0F,0x1C,0x1C,0x1C,0x1C,0x0F,0x07,0x00,0x00,0x00,0x00,0x00,0x00,0x00,
     0x00,0x7C,0xFE,0xC7,0x83,0x83,0x83,0xC7,0xFE,0x7C,0x00,0x00,0x00,0x00,0x00,0x00},
};

// 16x16 简化：仅数字 0-9（状态用）。其余字符回落小字体。
void oled_big(uint8_t y, const char *s) {
    if (y >= OLED_PAGES - 1 || !s) return;
    uint8_t x = 0;
    for (; *s && x <= OLED_W / 8 - 2; s++, x += 8) {
        char c = *s;
        if (c >= '0' && c <= '9') {
            const uint8_t *g = FONT16[c - '0'];
            for (int row = 0; row < 2; row++) {
                uint8_t *dst = s_fb + (y + row) * OLED_W + x;
                for (int col = 0; col < 8; col++) {
                    dst[col] = g[row * 16 + col * 2];
                    dst[col + 128] = g[row * 16 + col * 2 + 1];
                }
            }
        } else {
            // 空格清掉 8x16 区域
            for (int row = 0; row < 2; row++) {
                uint8_t *dst = s_fb + (y + row) * OLED_W + x;
                memset(dst, 0, 8);
            }
        }
    }
}

// ---------- 中文 16x16 渲染（UTF-8）----------
// 中文占 16px 宽 2 页高；ASCII 回落 6x8（顶部对齐）
void oled_cn(uint8_t x, uint8_t y, const char *s) {
    if (y >= OLED_PAGES - 1 || !s) return;
    uint8_t px = x;
    while (*s && px <= OLED_W - 16) {
        unsigned char c = (unsigned char)*s;
        if (c >= 0xE0 && s[1] && s[2]) {
            // 3 字节 UTF-8 中文
            const uint8_t *g = cn_lookup(s[0], s[1]);
            if (g) {
                for (int row = 0; row < 2; row++) {
                    uint8_t *dst = s_fb + (y + row) * OLED_W + px;
                    for (int col = 0; col < 8; col++) {
                        dst[col] = g[row * 16 + col * 2];
                        dst[col + 8] = g[row * 16 + col * 2 + 1];
                    }
                }
                s += 3;
                px += 16;
                continue;
            }
            s += 3;  // 字库没有的字跳过
            continue;
        } else if (c >= 0x80) {
            s++;  // 半个 UTF-8 字节跳过
            continue;
        } else {
            // ASCII 6x8（顶部页）
            if (c < 32 || c > 126) c = ' ';
            const uint8_t *g = FONT5X7[c - 32];
            uint8_t *dst = s_fb + y * OLED_W + px;
            for (int col = 0; col < 5; col++) dst[col] = g[col];
            dst[5] = 0;
            s++;
            px += 6;
        }
    }
}

void oled_cn_line(uint8_t y, const char *s) {
    oled_cn(0, y, s);
}
